## Guest/NuttX_V131/nuttx/arch/arm/src/armv7-m-rvm/Kconfig
```kconfig
#
# For a description of the syntax of this configuration file,
# see kconfig-language.txt in the NuttX tools repository.
#

if ARCH_CHIP_ARMV7M_RVM

comment "ARMv7-M RVM virtual chip"

choice
	prompt "Guest core and FPU"
	default ARMV7M_RVM_CORTEXM7

config ARMV7M_RVM_CORTEXM7
	bool "Cortex-M7 (FPv5)"
	select ARCH_CORTEXM7
	select ARCH_HAVE_DPFPU
	---help---
		The .rvp project assigned an ARMv7E-M core with the FPv5
		floating-point unit.  ARCH_DPFPU decides whether the toolchain
		uses the double-precision variant.

config ARMV7M_RVM_CORTEXM4
	bool "Cortex-M4 (FPv4-SP)"
	select ARCH_CORTEXM4
	select ARCH_HAVE_FPU
	---help---
		The .rvp project assigned a Cortex-M4 core with the FPv4-SP
		single-precision floating-point unit.

endchoice

config ARMV7M_RVM_FAST_PATH
	bool "Direct task-to-task context switch"
	default n
	depends on ARCH_FPU
	---help---
		Use the RVM direct switch fast path when both the outgoing and
		incoming frames are clean.  The slow path remains the reference
		and is used for every dirty or lazy-FPU frame.

endif # ARCH_CHIP_ARMV7M_RVM
```

## Guest/NuttX_V131/nuttx/boards/arm/armv7-m-rvm/ntx/Kconfig
```kconfig
#
# For a description of the syntax of this configuration file,
# see kconfig-language.txt in the NuttX tools repository.
#

if ARCH_BOARD_NTX

config NTX_RVM_ROOT
	string "RVM source root"
	default "C:/Code_Library/M7M02_Ammonite"
	---help---
		Root of the RVM monitor source tree.  The generated per-Virt board
		may override this with a relative path.

comment "RVM guest memory window"

config NTX_RVM_DATA_BASE
	hex "Guest data window base"
	default 0x24000000

config NTX_RVM_DATA_SIZE
	hex "Guest data window size"
	default 0x11f50

config NTX_RVM_STACK_BASE
	hex "Guest stack region base"
	default 0x24012000

config NTX_RVM_STACK_SIZE
	hex "Guest stack region size"
	default 0x1000

config NTX_RVM_DESC_BASE
	hex "Guest descriptor base"
	default 0x08050000

config NTX_RVM_CODE_BASE
	hex "Guest code base"
	default 0x08050020

config NTX_RVM_CODE_SIZE
	hex "Guest code size"
	default 0xffe0

config NTX_RVM_STATE_BASE
	hex "Monitor state block base"
	default 0x24011fc0

config NTX_RVM_STATE_SIZE
	hex "Monitor state block size"
	default 0x40

config NTX_RVM_REG_BASE
	hex "Monitor register block base"
	default 0x24011f50

config NTX_RVM_REG_SIZE
	hex "Monitor register block size"
	default 0x70

choice NTX_RVM_COP
	prompt "Guest coprocessor context"
	default NTX_RVM_COP_FPV5_DP

config NTX_RVM_COP_NONE
	bool "No floating-point context"
	---help---
		The Virt has no coprocessor context.  RVM_COP_NUM is zero and
		CONFIG_ARCH_FPU must not be selected.

config NTX_RVM_COP_FPV4_SP
	bool "FPv4-SP (Cortex-M4)"

config NTX_RVM_COP_FPV5_SP
	bool "FPv5-SP (Cortex-M7 single precision)"

config NTX_RVM_COP_FPV5_DP
	bool "FPv5-DP (Cortex-M7 double precision)"

endchoice

endif # ARCH_BOARD_NTX
```

## Guest/NuttX_V131/nuttx/boards/arm/armv7-m-rvm/ntx/configs/virt/defconfig
```kconfig
#
# NTX: NuttX on RVM, generic ARMv7-M virtual board.
# The RVM generator replaces this file per Virt.
#

CONFIG_ARCH="arm"
CONFIG_ARCH_BOARD="ntx"
CONFIG_ARCH_BOARD_NTX=y
CONFIG_ARCH_CHIP="armv7-m-rvm"
CONFIG_ARCH_CHIP_ARMV7M_RVM=y
CONFIG_ARCH_CORTEXM7=y
CONFIG_ARCH_FPU=y
CONFIG_ARMV7M_RVM_FAST_PATH=y
CONFIG_ARCH_DPFPU=y
CONFIG_ARMV7M_RVM_CORTEXM7=y
CONFIG_NTX_RVM_DATA_BASE=0x24000000
CONFIG_NTX_RVM_DATA_SIZE=0x11f50
CONFIG_NTX_RVM_STACK_BASE=0x24012000
CONFIG_NTX_RVM_STACK_SIZE=0x1000
CONFIG_NTX_RVM_DESC_BASE=0x08050000
CONFIG_NTX_RVM_CODE_BASE=0x08050020
CONFIG_NTX_RVM_CODE_SIZE=0xffe0
CONFIG_NTX_RVM_STATE_BASE=0x24011fc0
CONFIG_NTX_RVM_STATE_SIZE=0x40
CONFIG_NTX_RVM_REG_BASE=0x24011f50
CONFIG_NTX_RVM_REG_SIZE=0x70
CONFIG_NTX_RVM_COP_FPV5_DP=y
CONFIG_ARCH_IDLE_CUSTOM=y
CONFIG_ARCH_STACKDUMP=y
CONFIG_BOARD_LOOPSPERMSEC=100000
# CONFIG_BOARD_LATE_INITIALIZE is not set
CONFIG_DEBUG_SYMBOLS=y
CONFIG_DEFAULT_TASK_STACKSIZE=4096
CONFIG_DEV_CONSOLE=n
CONFIG_FDCLONE_DISABLE=y
CONFIG_DISABLE_ALL_SIGNALS=y
CONFIG_IDLETHREAD_STACKSIZE=2048
CONFIG_INIT_ENTRYPOINT="ntx_main"
CONFIG_INIT_PRIORITY=100
CONFIG_INIT_STACKSIZE=4096
CONFIG_INTELHEX_BINARY=y
CONFIG_MM_REGIONS=1
CONFIG_NTX_RVM_ROOT="C:/Code_Library/M7M02_Ammonite"
CONFIG_RAW_BINARY=y
CONFIG_RAM_SIZE=73552
CONFIG_RAM_START=0x24000000
CONFIG_START_DAY=6
CONFIG_START_MONTH=12
CONFIG_START_YEAR=2011
CONFIG_TASK_NAME_SIZE=0
```

## Guest/Zephyr_V370/zephyr/arch/arm/core/cortex_m/v7m_rvm/Kconfig
```kconfig
# SPDX-License-Identifier: Unlicense

config RVM_GUEST
	bool "RVM guest port"
	depends on CPU_CORTEX_M
	depends on !SMP
	depends on !USERSPACE
	depends on !ARM_MPU
	depends on !CORTEX_M_SYSTICK
	depends on !TICKLESS_KERNEL
	depends on !GEN_ISR_TABLES
	depends on !THREAD_LOCAL_STORAGE
	help
	  Build Zephyr as an unprivileged RVM guest on ARMv7-M.  The RVM
	  monitor owns the physical vector table, SVC, PendSV, SysTick and
	  the NVIC; this port replaces the normal Cortex-M reset, exception
	  and interrupt paths with the RVM virtual vector ABI.  The port
	  supports basic and FPU-extended exception frames; the unsupported
	  options above would silently corrupt the frame, leave the TLS
	  pointer stale, or bypass the RVM interrupt model.
```

## Guest/Zephyr_V370/zephyr/boards/rvm/armv7m/Kconfig.armv7m
```kconfig
# SPDX-License-Identifier: Unlicense

config BOARD_ARMV7M
	bool "RVM ARMv7-M guest"
	select SOC_RVM
```

## Guest/Zephyr_V370/zephyr/boards/rvm/armv7m/board.yml
```yaml
# SPDX-License-Identifier: Unlicense

board:
  name: armv7m
  vendor: rvm
  socs:
    - name: rvm
```

## Guest/Zephyr_V370/zephyr/soc/arm/v7m_rvm/Kconfig.soc
```kconfig
# SPDX-License-Identifier: Unlicense

config SOC_FAMILY_V7M_RVM
	bool

config SOC_FAMILY
	default "v7m_rvm" if SOC_FAMILY_V7M_RVM

config SOC_SERIES_V7M_RVM
	bool
	select SOC_FAMILY_V7M_RVM

config SOC_SERIES
	default "v7m_rvm" if SOC_SERIES_V7M_RVM

config SOC_RVM
	bool
	select SOC_SERIES_V7M_RVM
	select ARM

choice RVM_CPU
	prompt "RVM guest CPU"
	default RVM_CPU_M7
	help
	  The virtual board has one identity; the project generator selects
	  the CPU/FPU model from the virtual machine coprocessor.

config RVM_CPU_M7
	bool "Cortex-M7 / FPv5-DP"
	select CPU_CORTEX_M7
	select CPU_HAS_FPU
	select CPU_HAS_FPU_DOUBLE_PRECISION

config RVM_CPU_M4
	bool "Cortex-M4F / FPv4-SP"
	select CPU_CORTEX_M4
	select CPU_HAS_FPU

endchoice

config SOC
	default "rvm" if SOC_RVM
```
