## Project/GCCMF-STM32H743ZIT6-AQUARIUM/Virt_NTX/Project/ntx_board/configs/virt/defconfig
```kconfig
#
# NTX: NuttX on RVM, generic ARMv7-M virtual board.
# The RVM generator replaces this file per Virt.
#

CONFIG_ARCH="arm"
CONFIG_ARCH_BOARD="ntx"
CONFIG_ARCH_BOARD_NTX=y
CONFIG_ARCH_CHIP="armv7-m-rvm"
CONFIG_ARCH_CHIP_ARMV7M_RVM=y
CONFIG_ARCH_IDLE_CUSTOM=y
CONFIG_ARCH_STACKDUMP=y
CONFIG_BOARD_LOOPSPERMSEC=100000
# CONFIG_BOARD_LATE_INITIALIZE is not set
CONFIG_DEBUG_SYMBOLS=y
CONFIG_DEFAULT_TASK_STACKSIZE=4096
CONFIG_DEV_CONSOLE=n
CONFIG_FDCLONE_DISABLE=y
CONFIG_DISABLE_ALL_SIGNALS=y
CONFIG_IDLETHREAD_STACKSIZE=2048
CONFIG_INIT_ENTRYPOINT="ntx_main"
CONFIG_INIT_PRIORITY=100
CONFIG_INIT_STACKSIZE=4096
CONFIG_INTELHEX_BINARY=y
CONFIG_MM_REGIONS=1
CONFIG_RAW_BINARY=y
CONFIG_START_DAY=6
CONFIG_START_MONTH=12
CONFIG_START_YEAR=2011
CONFIG_TASK_NAME_SIZE=0
CONFIG_ARCH_CORTEXM7=y
CONFIG_ARMV7M_RVM_CORTEXM7=y
CONFIG_ARMV7M_RVM_FAST_PATH=y
CONFIG_NTX_RVM_DATA_BASE=0x24050000
CONFIG_NTX_RVM_DATA_SIZE=0xCF90
CONFIG_NTX_RVM_STACK_BASE=0x2405D000
CONFIG_NTX_RVM_STACK_SIZE=0x2000
CONFIG_NTX_RVM_DESC_BASE=0x8090000
CONFIG_NTX_RVM_CODE_BASE=0x8090020
CONFIG_NTX_RVM_CODE_SIZE=0xFFE0
CONFIG_NTX_RVM_STATE_BASE=0x2405CFC0
CONFIG_NTX_RVM_STATE_SIZE=0x40
CONFIG_NTX_RVM_REG_BASE=0x2405CF90
CONFIG_NTX_RVM_REG_SIZE=0x30
CONFIG_NTX_RVM_COP_NONE=y
CONFIG_NTX_RVM_ROOT="C:/Code_Library/M7M02_Ammonite/"
CONFIG_RAM_START=0x24050000
CONFIG_RAM_SIZE=53136
```
